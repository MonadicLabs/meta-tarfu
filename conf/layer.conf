## conf/layer.conf
```bitbake
# We have a conf and classes directory, append to BBPATH
BBPATH .= ":${LAYERDIR}"

# We have a recipes directory, add to BBFILES
BBFILES += "${LAYERDIR}/recipes*/*/*.bb ${LAYERDIR}/recipes*/*/*.bbappend"

# Machine-specific 'layer'
BBFILES += "${LAYERDIR}/${MACHINE}/recipes*/*/*.bb ${LAYERDIR}/${MACHINE}/recipes*/*/*.bbappend"

BBFILE_COLLECTIONS += "meta-tarfu"
BBFILE_PATTERN_meta-tarfu := "^${LAYERDIR}/"
BBFILE_PRIORITY_meta-tarfu = "10"

LAYERSERIES_COMPAT_meta-tarfu = "sumo thud"
```
